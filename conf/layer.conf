## conf/layer.conf
```bitbake
# We have a conf and classes directory, add to BBPATH
BBPATH .= ":${LAYERDIR}"

# We have recipes-* directories, add to BBFILES
BBFILES += "${LAYERDIR}/recipes-*/*/*.bb \
            ${LAYERDIR}/recipes-*/*/*.bbappend"

BBFILE_COLLECTIONS += "meta-nanopineo"
BBFILE_PATTERN_meta-nanopineo = "^${LAYERDIR}/"
BBFILE_PRIORITY_meta-nanopineo = "10"

LAYERDEPENDS_meta-nanopineo = "core"
LAYERSERIES_COMPAT_meta-nanopineo = "scarthgap"

# Kernel modules to be autoloaded.
KERNEL_MODULE_AUTOLOAD += "g_ether"
KERNEL_MODULE_PROBECONF += "g_ether"
module_conf_g_ether = "options g_ether dev_addr=c0:00:20:35:45:01 host_addr=c0:00:20:35:45:00"
```
